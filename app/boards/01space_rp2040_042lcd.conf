## app/boards/01space_rp2040_042lcd.conf
```kconfig
CONFIG_ZMK_DISPLAY=y
CONFIG_LVGL_FONT_UNSCII_8=n
CONFIG_ZMK_USB=y
CONFIG_I2C=y
CONFIG_I2C_DW=y
CONFIG_LVGL_VDB_SIZE=50
```

## app/boards/shields/amoeba2/Kconfig.shield
```kconfig
# Copyright (c) 2022 The ZMK Contributors
# SPDX-License-Identifier: MIT

config SHIELD_AMOEBA2_LEFT
	def_bool $(shields_list_contains,amoeba2_left)

config SHIELD_AMOEBA2_RIGHT
	def_bool $(shields_list_contains,amoeba2_right)
```

## app/boards/shields/solderless/Kconfig.defconfig
```kconfig
# Copyright (c) 2020 The ZMK Contributors
# SPDX-License-Identifier: MIT

if SHIELD_SOLDERLESS_LEFT

config ZMK_KEYBOARD_NAME
	default "Solderless"

config ZMK_SPLIT_ROLE_CENTRAL
	default y

endif

if SHIELD_SOLDERLESS_LEFT || SHIELD_SOLDERLESS_RIGHT

config ZMK_SPLIT
	default y

endif
```

## app/boards/shields/solderless/Kconfig.shield
```kconfig
# Copyright (c) 2020 The ZMK Contributors
# SPDX-License-Identifier: MIT

config SHIELD_SOLDERLESS_LEFT
	def_bool $(shields_list_contains,solderless_left)

config SHIELD_SOLDERLESS_RIGHT
	def_bool $(shields_list_contains,solderless_right)
```

## app/boards/shields/zmk_uno/Kconfig.defconfig
```kconfig
# Copyright (c) 2022 The ZMK Contributors
# SPDX-License-Identifier: MIT

if SHIELD_ZMK_UNO

config ZMK_KEYBOARD_NAME
    default "ZMK Uno"

endif
```

## app/drivers/sensor/ma730/Kconfig
```kconfig
config MA730
	bool "MA730 Angular position sensor"
	depends on SPI
	help
	  Enable angular encoder sensor

		The MA730 is a 16-bit contactless magnetic encoder, communicating over spi

if MA730

choice
	prompt "Trigger mode"
	default MA730_TRIGGER_NONE
	help
	  Specify the type of triggering to be used by the driver.

config MA730_TRIGGER_NONE
	bool "No trigger"

config MA730_TRIGGER_GLOBAL_THREAD
	bool "Use global thread"
	depends on GPIO
	select MA730_TRIGGER

config MA730_TRIGGER_OWN_THREAD
	bool "Use own thread"
	depends on GPIO
	select MA730_TRIGGER

endchoice

config MA730_TRIGGER
	bool

config MA730_THREAD_PRIORITY
	int "Thread priority"
	depends on MA730_TRIGGER_OWN_THREAD
	default 10
	help
	  Priority of thread used by the driver to handle interrupts.

config MA730_THREAD_STACK_SIZE
	int "Thread stack size"
	depends on MA730_TRIGGER_OWN_THREAD
	default 1024
	help
	  Stack size of thread used by the driver to handle interrupts.

endif # MA730
```

## app/drivers/zephyr/dts/bindings/sensor/magalpha,ma730.yaml
```yaml
description: |
  Sensor driver for the Magalpha MA730 rotary encoder

compatible: "magalpha,ma730"

include: spi-device.yaml

properties:
  label:
    type: string
    required: true
  a-gpios:
    type: phandle-array
    required: true
    description: A pin for the encoder
  b-gpios:
    type: phandle-array
    required: true
    description: A pin for the encoder
  resolution:
    type: int
    description: Number of pulses per tick
    required: false
```

## app/src/shell/Kconfig
```kconfig
menu "Shell"

config ZMK_SHELL_KEY_POSITIONS
    bool "Key Position commands"
    depends on SHELL
    
endmenu
```

## app/west.yml
```yaml
manifest:
  remotes:
    - name: zephyrproject-rtos
      url-base: https://github.com/zephyrproject-rtos
    - name: bobobo1618
      url-base: https://github.com/bobobo1618
  projects:
    - name: zephyr
      remote: bobobo1618
      revision: fix-oled
      clone-depth: 1
      import:
        # TODO: Rename once upstream offers option like `exclude` or `denylist`
        name-blacklist:
          - ci-tools
          - hal_altera
          - hal_cypress
          - hal_infineon
          - hal_microchip
          - hal_nxp
          - hal_openisa
          - hal_silabs
          - hal_xtensa
          - hal_st
          - hal_ti
          - loramac-node
          - mcuboot
          - mcumgr
          - net-tools
          - openthread
          - edtt
          - trusted-firmware-m
          - sof
  self:
    west-commands: scripts/west-commands.yml
```
