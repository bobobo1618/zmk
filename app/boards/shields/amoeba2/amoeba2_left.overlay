/*
 * Copyright (c) 2022 The ZMK Contributors
 *
 * SPDX-License-Identifier: MIT
 */

#include "amoeba2.dtsi"

/ {
	chosen {
		zmk,kscan = &kscan;
	};

	kscan: kscan {
		compatible = "zmk,kscan-gpio-matrix";

		label = "KSCAN";
		diode-direction = "col2row";

		col-gpios
			= <&pro_micro 5 GPIO_ACTIVE_HIGH>
			, <&pro_micro 6 GPIO_ACTIVE_HIGH>
			, <&pro_micro 7 GPIO_ACTIVE_HIGH>
			, <&pro_micro 8 GPIO_ACTIVE_HIGH>
			, <&pro_micro 9 GPIO_ACTIVE_HIGH>
			;

		row-gpios 
			= <&pro_micro 10 (GPIO_PULL_DOWN | GPIO_ACTIVE_HIGH)>
			, <&pro_micro 16 (GPIO_PULL_DOWN | GPIO_ACTIVE_HIGH)>
			, <&pro_micro 14 (GPIO_PULL_DOWN | GPIO_ACTIVE_HIGH)>
			, <&pro_micro 15 (GPIO_PULL_DOWN | GPIO_ACTIVE_HIGH)>
			;
	};
};

